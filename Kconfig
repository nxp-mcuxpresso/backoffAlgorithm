## Kconfig
```kconfig
#
# Copyright 2024-2026 NXP
#
# SPDX-License-Identifier: BSD-3-Clause
#

menuconfig MCUX_COMPONENT_middleware.freertos.backoffalgorithm
    bool "backoffalgorithm"
    default n
    help
        Algorithm for calculating exponential backoff with jitter for network
```
